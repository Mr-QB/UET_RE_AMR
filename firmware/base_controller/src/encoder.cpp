#include "encoder.h"
 
// ENCODER String for one way rotation(3 encoder) : ...3-1-5-4-6-2-3-1.. (bit packing)
// 3 = 011, 1 = 001, 5 = 101, 4 = 100, 6 = 110, 2 = 010
// if you use more than 3 encoder, you need to find out the encoder string for your encoder, and then you can use the lookup table of your encoder to detect the movement and direction of rotation.
// you also need to find out the number of steps per rotation for your encoder, and then you can use the steps per rotation to calculate the velocity of the encoder.
// the motor used in this project have 90 steps per rotation.
// measure time difference between two encoder output, and then you can use the time difference to calculate the angular velocity of the encoder, and then you can use the angular velocity to calculate the linear velocity of the wheel.
// lookup table for 3 encoder, 6 states, there no 0 and 7 state, because three encoder sensors are arranged with a 120 degree phase shift.
// if your encoder status is 0 or 7, it means that the encoder is not working properly, and you need to check the encoder wiring and the encoder sensor.
//              1   5   4   6   2   3
// pre \ cur   001 101 100 110 010 011
// 1  001       0   1   2  999 -2  -1
// 5  101      -1   0   1   2  999 -2
// 4  100      -2  -1   0   1   2  999
// 6  110      999 -2  -1   0   1   2
// 2  010       2  999 -2  -1   0   1
// 3  011       1   2  999 -2  -1   0    . 999 is error, max step is 2
// if frequency of loop higher than encoder output frequency many time, you can remove step 2/-2
 
// convert to 2D array column from 1-6, row from 1-6
int transition[7][7] = {
    //        0     1     2     3     4     5     6     7
    /*0*/  { 999,  999,  999,  999,  999,  999,  999},
    /*1*/  { 999,   0 ,  -2 ,  -1 ,   2 ,   1 ,  999},
    /*2*/  { 999,   2 ,   0 ,   1 ,  -2 ,  999,  -1 },
    /*3*/  { 999,   1 ,  -1 ,   0 ,  999,   2 ,  -2 },
    /*4*/  { 999,  -2 ,   2 ,  999,   0 ,  -1 ,   1 },
    /*5*/  { 999,  -1 ,  999,  -2 ,   1 ,   0 ,   2 },
    /*6*/  { 999,  999,   1 ,   2 ,  -1 ,  -2 ,   0 }
};
// move = transition[prev][cur] or move = -transition[prev][cur] : Depending on the direction of rotation
 
// *Note: when the electronic speed controller(ESC) running motor may cause ground bounce, which can alter the effective GPIO input threshold and lead to false logic state detection of encoder status.
// The MCU's internal pull-up resistor is relatively weak (typically 20-50 kΩ), making the GPIO input vulnerable to ground noise generated by high-power motor operation.
// Replacing the internal pull-up with a stronger external pull-up resistor (1-10 kΩ) significantly improves noise immunity.
// Additional measures such as proper grounding, RC filtering, shielded cables, or galvanic isolation may also be required in electrically noisy environments.
 
void Encoder::Init(uint8_t A, uint8_t B, uint8_t C, uint16_t stepsPerRotation, float radius, bool clockwise) {
  this->A = A;
  this->B = B;
  this->C = C;
  this->stepsPerRotation = stepsPerRotation;
  this->radius = radius;
  this->clockwise = clockwise;
  if(clockwise) {
    cw = 1;
  } else {
    cw = -1;
  }
  pinMode(A, INPUT); // if you use pullup resistor, you can use INPUT_PULLUP
  pinMode(B, INPUT);
  pinMode(C, INPUT);
  this->prevState = (digitalRead(A) << 2) | (digitalRead(B) << 1) | digitalRead(C);
  this->lastTime = micros();
}
 
void Encoder::reset() {
  // Reset encoder state if needed
  position = 0;
  velocity = 0;
  velocity_inst = 0;
  velocity_avg = 0;
  prev_velocity = 0;
  lastTime = micros();
  lastPosition = 0;
  dt = 0;
  stepAccum = 0;
  stepStartTime = 0;
  avgReady = false;
}
 
void Encoder::readEncoder(int32_t *position, double *velocity) {
 
  currState = (digitalRead(A) << 2) | (digitalRead(B) << 1) | digitalRead(C);
  int temp = position_detect(currState, &prevState);
  this->position += cw * temp;
 
  const uint16_t STEP_SAMPLE = 30;    // number of encoder steps to accumulate for the averaged velocity
  const uint32_t MAX_DT = 50000;      // 50 ms - longer than this, dt is considered unreliable (stopped/missed pulses)
  const uint32_t MIN_DT = 50;         // 50 us - shorter than this is noise/bounce, skip it to avoid dividing by ~0
 
  if (this->position != lastPosition && temp != 0) {
 
    uint32_t now = micros();
    dt = now - this->lastTime;   // FIX: compute dt BEFORE updating lastTime (previously computed after, so it was always 0)
 
    // ---------- Method 1: instantaneous velocity between 2 consecutive state changes ----------
    // FIX: multiply by abs(temp) because a transition can jump 2 steps in a single read
    // (if a state was missed due to the loop frequency not being fast enough); without
    // this multiplier the velocity would be underestimated by up to ~50% at high speed.
    if (dt > MIN_DT && dt < MAX_DT) {
      float v = 2.0f * PI * radius * 1000000.0f * abs(temp) / (stepsPerRotation * (float)dt);
      if (cw * temp < 0) v = -v;
      velocity_inst = v * 0.8f + prev_velocity * 0.2f; // low-pass filter to reduce noise
      prev_velocity = velocity_inst;
    }
    // if dt is out of range (too short/too long), keep the previous velocity_inst instead of updating with bad data
 
    this->lastTime = now; // update lastTime only ONCE, after it has been used to compute dt
 
    // ---------- Method 2: averaged velocity over a batch of STEP_SAMPLE steps ----------
    if (stepAccum == 0) stepStartTime = now;
    stepAccum += abs(temp);
 
    if (stepAccum >= STEP_SAMPLE) {
      uint32_t elapsed = now - stepStartTime;
      if (elapsed > 0) {
        float v_avg = (stepAccum * 2.0f * PI * radius) / (stepsPerRotation * (elapsed * 1e-6f));
        if (cw * temp < 0) v_avg = -v_avg;
        velocity_avg = v_avg;
        avgReady = true;
      }
      stepAccum = 0;
    }
 
    lastPosition = this->position;
 
  } else if (micros() - this->lastTime >= 100000) {
    // No new pulse for 100ms -> assume the wheel has fully stopped
    velocity_inst = 0;
    velocity_avg = 0;
    prev_velocity = 0;
    stepAccum = 0;
  }
 
  // ---------- Combine both methods to get the most reliable velocity ----------
  // velocity_inst: fast response (updates every pulse) but noisier, since the 3 sensors
  //                are 120 degrees apart, so the angular spacing between steps is uneven.
  // velocity_avg : smoother and more accurate at steady speed (averaged over many steps),
  //                but lags (only updates every STEP_SAMPLE steps).
  // Combination rule: if the two values diverge too much (velocity_inst is likely noisy),
  // trust the averaged value; otherwise take a weighted average of both so the result is
  // both smooth and responsive.
  if (!avgReady) {
    this->velocity = velocity_inst;
  } else if (fabsf(velocity_avg) > 0.001f &&
             fabsf(velocity_inst - velocity_avg) > 0.5f * fabsf(velocity_avg)) {
    this->velocity = velocity_avg;
  } else {
    this->velocity = 0.5f * velocity_inst + 0.5f * velocity_avg;
  }
 
  *position = this->position;
  *velocity = this->velocity;
}
 
int position_detect(byte curr, byte* prev) { // use lookup table to detect movement, direction of rotation
  byte prev_temp = *prev;
  *prev = curr;
  if (transition[prev_temp][curr] == 999) {
    // return transition[prev_temp][curr]; // for debugging, you can use this line to check the error state
    // if error state exists too frequently, you have to check the encoder wiring and the encoder sensor, or you can use a stronger external pull-up resistor (1-10 kΩ) to improve noise immunity.
    // if error state exists rarely, you can ignore it, because the error state is caused by the encoder output frequency being higher than the loop frequency, and the error state will not affect the final result.
    return 0;
  } else {
    return transition[prev_temp][curr];
  }
}